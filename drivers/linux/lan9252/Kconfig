## drivers/linux/lan9252/Kconfig
```kconfig
config LAN9252
	tristate "Microchip LAN9252(ethercat slave controller) support"
	help
	  SPI driver for Microchip LAN9252 ethercat slave controller interface.
```

## soes/linux/kernel-lan9252/Kconfig
```kconfig
config SPI_LAN9252
	tristate "Microchip LAN9252(ehtercat device) support"
	help
	  SPI driver for Microchip LAN9252 ethercat Controller interface.
```
